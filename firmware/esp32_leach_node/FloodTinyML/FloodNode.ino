/*
  ============================================================
  ENVIRON-X - FLOOD TINYML NODE
  ============================================================
  Target:
    ESP32 + BMP280 x2 + Water Level + Soil Moisture

  ML model:
    flood_model.h generated by emlearn from your Colab model.

  IMPORTANT:
    This sketch matches the uploaded training notebook:
      - NO scaler / MinMax normalization
      - 10 model features, in the exact training order
      - model input is int16_t
      - 30-tree Random Forest
      - flood_model_predict() and flood_model_predict_proba()

  Pipeline:
    Sensors
      -> median filter
      -> EMA filter
      -> 30-s rolling window
      -> feature extraction
      -> int16 conversion
      -> TinyML Random Forest
      -> probability / NORMAL / FLOOD_RISK
      -> 3 consecutive confirmations
      -> LED / buzzer
      -> cloud-ready JSON on Serial

  Put flood_model.h in the SAME folder as this .ino file.

  Install Arduino libraries:
    - Adafruit BMP280 Library
    - Adafruit Unified Sensor

  NOTE:
    Wi-Fi/MQTT is intentionally not required in this file.
    The Serial JSON output is ready for the cloud/MQTT layer.
*/

#include <Arduino.h>
#include <Wire.h>
#include <Adafruit_BMP280.h>
#include "flood_model.h"

// ============================================================
// 1. HARDWARE PINS
// ============================================================

#define WATER_LEVEL_PIN 34
#define SOIL_MOISTURE_PIN 35

#define LED_GREEN_PIN 2
#define LED_RED_PIN   4
#define BUZZER_PIN    5

// ============================================================
// 2. NODE CONFIG
// ============================================================

const char* NODE_ID = "FLOOD-01";
const char* MODEL_VERSION = "flood_rf_v1";

const float SAMPLE_HZ = 1.0f;
const unsigned long SAMPLE_INTERVAL_MS = 1000;
const unsigned long INFERENCE_INTERVAL_MS = 5000;

const int WINDOW_SIZE = 30;
const int MEDIAN_SIZE = 5;

// Require 3 consecutive model-positive inferences
// before declaring a confirmed flood.
const int CONFIRM_COUNT = 3;

// ============================================================
// 3. BMP280
// ============================================================

Adafruit_BMP280 bmp1;
Adafruit_BMP280 bmp2;

const uint8_t BMP1_ADDRESS = 0x76;
const uint8_t BMP2_ADDRESS = 0x77;

// ============================================================
// 4. FILTERS
// ============================================================

float waterMedianBuffer[MEDIAN_SIZE] = {0};
float soilMedianBuffer[MEDIAN_SIZE]  = {0};

int waterMedianIndex = 0;
int soilMedianIndex = 0;

float filteredWater = 0.0f;
float filteredSoil = 0.0f;

bool filtersInitialized = false;

// EMA: 0.20 = smoother, 0.30 = more responsive
const float EMA_ALPHA = 0.20f;

// ============================================================
// 5. ROLLING WINDOWS
// ============================================================

float waterHistory[WINDOW_SIZE] = {0};
float soilHistory[WINDOW_SIZE] = {0};
float temperatureHistory[WINDOW_SIZE] = {0};
float pressureHistory[WINDOW_SIZE] = {0};

int historyIndex = 0;
int samplesCollected = 0;

// ============================================================
// 6. STATE
// ============================================================

unsigned long lastSampleTime = 0;
unsigned long lastInferenceTime = 0;

int predictionHistory[CONFIRM_COUNT] = {0, 0, 0};

int latestPrediction = 0;
bool floodConfirmed = false;

float latestFloodProbability = 0.0f;
float latestNormalProbability = 1.0f;

unsigned long lastInferenceMicros = 0;

// ============================================================
// 7. UTILITY
// ============================================================

float clampFloat(float x, float lo, float hi) {
  if (x < lo) return lo;
  if (x > hi) return hi;
  return x;
}

float median5(float a, float b, float c, float d, float e) {
  float x[5] = {a, b, c, d, e};

  for (int i = 0; i < 5; ++i) {
    for (int j = i + 1; j < 5; ++j) {
      if (x[j] < x[i]) {
        float t = x[i];
        x[i] = x[j];
        x[j] = t;
      }
    }
  }

  return x[2];
}

float emaFilter(float current, float previous) {
  return EMA_ALPHA * current +
         (1.0f - EMA_ALPHA) * previous;
}

float meanOf(const float* buffer, int size) {
  if (size <= 0) return 0.0f;

  float sum = 0.0f;
  for (int i = 0; i < size; ++i) {
    sum += buffer[i];
  }
  return sum / (float)size;
}

float maxOf(const float* buffer, int size) {
  if (size <= 0) return 0.0f;

  float m = buffer[0];

  for (int i = 1; i < size; ++i) {
    if (buffer[i] > m) {
      m = buffer[i];
    }
  }

  return m;
}

// ============================================================
// 8. SENSOR CALIBRATION
// ============================================================
//
// IMPORTANT:
// These conversions are PLACEHOLDERS.
// Replace them with measurements from your actual sensors.
//
// The ML model expects:
//   water_level       -> cm
//   soil_moisture     -> %
//   temperature       -> °C
//   pressure          -> hPa
// ============================================================

float waterRawToCm(int raw) {
  // Example ADC -> 0..100 cm conversion.
  // Calibrate this for your actual water-level sensor.
  const float ADC_MIN = 0.0f;
  const float ADC_MAX = 4095.0f;
  const float LEVEL_MIN_CM = 0.0f;
  const float LEVEL_MAX_CM = 100.0f;

  float level =
      LEVEL_MIN_CM +
      ((raw - ADC_MIN) / (ADC_MAX - ADC_MIN)) *
      (LEVEL_MAX_CM - LEVEL_MIN_CM);

  return clampFloat(level, LEVEL_MIN_CM, LEVEL_MAX_CM);
}

float soilRawToPercent(int raw) {
  // Example calibration:
  // DRY_ADC = observed dry-soil value
  // WET_ADC = observed saturated-soil value
  const int DRY_ADC = 3000;
  const int WET_ADC = 1200;

  if (DRY_ADC == WET_ADC) return 0.0f;

  float moisture =
      ((float)(DRY_ADC - raw) /
       (float)(DRY_ADC - WET_ADC)) * 100.0f;

  return clampFloat(moisture, 0.0f, 100.0f);
}

// ============================================================
// 9. SENSOR READINGS
// ============================================================

float readWaterLevelCm() {
  int raw = analogRead(WATER_LEVEL_PIN);
  return waterRawToCm(raw);
}

float readSoilMoisturePct() {
  int raw = analogRead(SOIL_MOISTURE_PIN);
  return soilRawToPercent(raw);
}

float readAverageTemperatureC() {
  float t1 = bmp1.readTemperature();
  float t2 = bmp2.readTemperature();

  if (isnan(t1) || isnan(t2)) {
    return NAN;
  }

  return (t1 + t2) * 0.5f;
}

float readAveragePressureHpa() {
  float p1 = bmp1.readPressure() / 100.0f;
  float p2 = bmp2.readPressure() / 100.0f;

  if (isnan(p1) || isnan(p2)) {
    return NAN;
  }

  return (p1 + p2) * 0.5f;
}

bool bmpSensorsHealthy() {
  float t1 = bmp1.readTemperature();
  float t2 = bmp2.readTemperature();

  float p1 = bmp1.readPressure() / 100.0f;
  float p2 = bmp2.readPressure() / 100.0f;

  if (isnan(t1) || isnan(t2) ||
      isnan(p1) || isnan(p2)) {
    return false;
  }

  // Simple consistency checks.
  if (fabs(t1 - t2) > 5.0f) {
    return false;
  }

  if (fabs(p1 - p2) > 10.0f) {
    return false;
  }

  return true;
}

// ============================================================
// 10. FILTERING
// ============================================================

float filteredWaterReading(float raw) {

  waterMedianBuffer[waterMedianIndex] = raw;

  waterMedianIndex++;
  if (waterMedianIndex >= MEDIAN_SIZE) {
    waterMedianIndex = 0;
  }

  float med;

  if (!filtersInitialized) {
    med = raw;
  } else {
    med = median5(
      waterMedianBuffer[0],
      waterMedianBuffer[1],
      waterMedianBuffer[2],
      waterMedianBuffer[3],
      waterMedianBuffer[4]
    );
  }

  if (!filtersInitialized) {
    filteredWater = med;
  } else {
    filteredWater = emaFilter(med, filteredWater);
  }

  return filteredWater;
}

float filteredSoilReading(float raw) {

  soilMedianBuffer[soilMedianIndex] = raw;

  soilMedianIndex++;
  if (soilMedianIndex >= MEDIAN_SIZE) {
    soilMedianIndex = 0;
  }

  float med;

  if (!filtersInitialized) {
    med = raw;
  } else {
    med = median5(
      soilMedianBuffer[0],
      soilMedianBuffer[1],
      soilMedianBuffer[2],
      soilMedianBuffer[3],
      soilMedianBuffer[4]
    );
  }

  if (!filtersInitialized) {
    filteredSoil = med;
  } else {
    filteredSoil = emaFilter(med, filteredSoil);
  }

  return filteredSoil;
}

// ============================================================
// 11. ROLLING WINDOW
// ============================================================

void addSample(
  float water,
  float soil,
  float temperature,
  float pressure
) {
  waterHistory[historyIndex] = water;
  soilHistory[historyIndex] = soil;
  temperatureHistory[historyIndex] = temperature;
  pressureHistory[historyIndex] = pressure;

  historyIndex++;

  if (historyIndex >= WINDOW_SIZE) {
    historyIndex = 0;
  }

  if (samplesCollected < WINDOW_SIZE) {
    samplesCollected++;
  }
}

float newestValue(const float* buffer) {
  int newestIndex = historyIndex - 1;

  if (newestIndex < 0) {
    newestIndex = WINDOW_SIZE - 1;
  }

  return buffer[newestIndex];
}

float oldestValue(const float* buffer) {
  if (samplesCollected < WINDOW_SIZE) {
    return buffer[0];
  }

  return buffer[historyIndex];
}

float rateOfChange(const float* buffer) {
  if (samplesCollected < 2) {
    return 0.0f;
  }

  float oldest = oldestValue(buffer);
  float newest = newestValue(buffer);

  float elapsedSeconds =
      (samplesCollected - 1) *
      (SAMPLE_INTERVAL_MS / 1000.0f);

  if (elapsedSeconds <= 0.0f) {
    return 0.0f;
  }

  return (newest - oldest) / elapsedSeconds;
}

// ============================================================
// 12. PREDICTION CONFIRMATION
// ============================================================

bool updateConfirmation(int prediction) {

  for (int i = 0; i < CONFIRM_COUNT - 1; ++i) {
    predictionHistory[i] =
        predictionHistory[i + 1];
  }

  predictionHistory[CONFIRM_COUNT - 1] =
      prediction;

  return
      predictionHistory[0] == 1 &&
      predictionHistory[1] == 1 &&
      predictionHistory[2] == 1;
}

// ============================================================
// 13. LOCAL ALERTS
// ============================================================

void setNormalIndicators() {
  digitalWrite(LED_GREEN_PIN, HIGH);
  digitalWrite(LED_RED_PIN, LOW);
  digitalWrite(BUZZER_PIN, LOW);
}

void setFloodIndicators() {
  digitalWrite(LED_GREEN_PIN, LOW);
  digitalWrite(LED_RED_PIN, HIGH);
  digitalWrite(BUZZER_PIN, HIGH);
}

void setSensorFaultIndicators() {
  digitalWrite(LED_GREEN_PIN, LOW);
  digitalWrite(LED_RED_PIN, LOW);
  digitalWrite(BUZZER_PIN, LOW);
}

// ============================================================
// 14. CLOUD-READY JSON
// ============================================================
//
// This JSON is printed on Serial now.
// Later, publish the SAME JSON through MQTT.
// ============================================================

void printCloudPayload(
  float waterLevel,
  float waterRate,
  float waterMean,
  float waterMax,
  float soilMoisture,
  float soilRate,
  float soilMean,
  float temperature,
  float pressure,
  float pressureChange
) {

  Serial.println("{");

  Serial.print("  \"node_id\":\"");
  Serial.print(NODE_ID);
  Serial.println("\",");

  Serial.print("  \"model_version\":\"");
  Serial.print(MODEL_VERSION);
  Serial.println("\",");

  Serial.print("  \"timestamp_ms\":");
  Serial.println(millis());

  Serial.println("  ,\"sensor\":{");

  Serial.print("    \"water_level_cm\":");
  Serial.print(waterLevel, 3);
  Serial.println(",");

  Serial.print("    \"soil_moisture_pct\":");
  Serial.print(soilMoisture, 3);
  Serial.println(",");

  Serial.print("    \"temperature_c\":");
  Serial.print(temperature, 3);
  Serial.println(",");

  Serial.print("    \"pressure_hpa\":");
  Serial.print(pressure, 3);
  Serial.println();

  Serial.println("  },");

  Serial.println("  \"features\":{");

  Serial.print("    \"water_level_rate_cm_s\":");
  Serial.print(waterRate, 6);
  Serial.println(",");

  Serial.print("    \"water_level_mean_cm\":");
  Serial.print(waterMean, 3);
  Serial.println(",");

  Serial.print("    \"water_level_max_cm\":");
  Serial.print(waterMax, 3);
  Serial.println(",");

  Serial.print("    \"soil_moisture_rate_pct_s\":");
  Serial.print(soilRate, 6);
  Serial.println(",");

  Serial.print("    \"soil_moisture_mean_pct\":");
  Serial.print(soilMean, 3);
  Serial.println(",");

  Serial.print("    \"pressure_change_hpa\":");
  Serial.print(pressureChange, 3);
  Serial.println();

  Serial.println("  },");

  Serial.println("  \"ai\":{");

  Serial.print("    \"prediction\":\"");
  Serial.print(
      latestPrediction == 1 ?
      "FLOOD_RISK" :
      "NORMAL"
  );
  Serial.println("\",");

  Serial.print("    \"flood_probability_percent\":");
  Serial.print(latestFloodProbability, 2);
  Serial.println(",");

  Serial.print("    \"normal_probability_percent\":");
  Serial.print(latestNormalProbability, 2);
  Serial.println(",");

  Serial.print("    \"confirmed\":");
  Serial.print(
      floodConfirmed ?
      "true" :
      "false"
  );
  Serial.println(",");

  Serial.print("    \"inference_us\":");
  Serial.print(lastInferenceMicros);
  Serial.println();

  Serial.println("  }");

  Serial.println("}");
}

// ============================================================
// 15. RUN MODEL
// ============================================================

void runInference() {

  if (samplesCollected < WINDOW_SIZE) {

    Serial.print("Collecting rolling window: ");
    Serial.print(samplesCollected);
    Serial.print("/");
    Serial.println(WINDOW_SIZE);

    return;
  }

  // -----------------------------------------
  // Raw / derived features
  // -----------------------------------------

  float waterLevel =
      newestValue(waterHistory);

  float waterRate =
      rateOfChange(waterHistory);

  float waterMean =
      meanOf(
        waterHistory,
        WINDOW_SIZE
      );

  float waterMax =
      maxOf(
        waterHistory,
        WINDOW_SIZE
      );

  float soilMoisture =
      newestValue(soilHistory);

  float soilRate =
      rateOfChange(soilHistory);

  float soilMean =
      meanOf(
        soilHistory,
        WINDOW_SIZE
      );

  float temperature =
      meanOf(
        temperatureHistory,
        WINDOW_SIZE
      );

  float pressure =
      meanOf(
        pressureHistory,
        WINDOW_SIZE
      );

  float pressureChange =
      newestValue(pressureHistory) -
      oldestValue(pressureHistory);

  // -----------------------------------------
  // EXACT training feature order
  // -----------------------------------------

  float rawFeatures[10] = {

    waterLevel,       // 0
    waterRate,        // 1
    waterMean,        // 2
    waterMax,         // 3

    soilMoisture,     // 4
    soilRate,         // 5
    soilMean,         // 6

    temperature,      // 7
    pressure,         // 8
    pressureChange    // 9
  };

  // -----------------------------------------
  // Model expects int16_t.
  //
  // The uploaded Colab notebook did NOT apply
  // MinMaxScaler or other explicit scaling.
  //
  // Therefore we directly convert each
  // training feature to int16_t.
  // -----------------------------------------

  int16_t modelInput[10];

  for (int i = 0; i < 10; ++i) {

    if (isnan(rawFeatures[i]) ||
        isinf(rawFeatures[i])) {

      Serial.println(
        "ERROR: Invalid feature value"
      );

      sensorFaultIndicator();
      return;
    }

    modelInput[i] =
        (int16_t)lroundf(rawFeatures[i]);
  }

  // -----------------------------------------
  // Print model inputs for debugging
  // -----------------------------------------

  Serial.println();
  Serial.println("========== MODEL INPUT ==========");

  for (int i = 0; i < 10; ++i) {

    Serial.print("feature[");
    Serial.print(i);
    Serial.print("] = ");
    Serial.println(modelInput[i]);
  }

  // -----------------------------------------
  // TinyML inference
  // -----------------------------------------

  unsigned long start =
      micros();

  latestPrediction =
      flood_model_predict(
        modelInput,
        10
      );

  float probabilities[2] = {
    0.0f,
    0.0f
  };

  flood_model_predict_proba(
    modelInput,
    10,
    probabilities,
    2
  );

  lastInferenceMicros =
      micros() - start;

  latestNormalProbability =
      probabilities[0] * 100.0f;

  latestFloodProbability =
      probabilities[1] * 100.0f;

  // -----------------------------------------
  // Consecutive-result confirmation
  // -----------------------------------------

  floodConfirmed =
      updateConfirmation(
        latestPrediction
      );

  // -----------------------------------------
  // Local action
  // -----------------------------------------

  if (floodConfirmed) {
    setFloodIndicators();
  }
  else {
    setNormalIndicators();
  }

  // -----------------------------------------
  // Serial output
  // -----------------------------------------

  Serial.println();
  Serial.println("========== FLOOD AI ==========");

  Serial.print("Prediction      : ");

  if (latestPrediction == 1) {
    Serial.println("FLOOD_RISK");
  }
  else {
    Serial.println("NORMAL");
  }

  Serial.print("Flood probability: ");
  Serial.print(
      latestFloodProbability,
      2
  );
  Serial.println("%");

  Serial.print("Normal probability: ");
  Serial.print(
      latestNormalProbability,
      2
  );
  Serial.println("%");

  Serial.print("Confirmed         : ");
  Serial.println(
      floodConfirmed ?
      "YES" :
      "NO"
  );

  Serial.print("Inference time    : ");
  Serial.print(lastInferenceMicros);
  Serial.println(" us");

  Serial.println();

  // -----------------------------------------
  // Cloud-ready payload
  // -----------------------------------------

  printCloudPayload(
    waterLevel,
    waterRate,
    waterMean,
    waterMax,
    soilMoisture,
    soilRate,
    soilMean,
    temperature,
    pressure,
    pressureChange
  );
}

// ============================================================
// 16. SETUP
// ============================================================

void setup() {

  Serial.begin(115200);
  delay(1000);

  Serial.println();
  Serial.println("======================================");
  Serial.println(" ENVIRON-X FLOOD TINYML NODE");
  Serial.println("======================================");

  pinMode(LED_GREEN_PIN, OUTPUT);
  pinMode(LED_RED_PIN, OUTPUT);
  pinMode(BUZZER_PIN, OUTPUT);

  setNormalIndicators();

  // ESP32 ADC
  analogReadResolution(12);

  // I2C
  Wire.begin();

  // -----------------------------------------
  // BMP280 #1
  // -----------------------------------------

  if (!bmp1.begin(BMP1_ADDRESS)) {

    Serial.println(
      "ERROR: BMP280 #1 not found."
    );

    setSensorFaultIndicators();

    while (true) {
      digitalWrite(
        LED_RED_PIN,
        !digitalRead(LED_RED_PIN)
      );
      delay(300);
    }
  }

  // -----------------------------------------
  // BMP280 #2
  // -----------------------------------------

  if (!bmp2.begin(BMP2_ADDRESS)) {

    Serial.println(
      "ERROR: BMP280 #2 not found."
    );

    setSensorFaultIndicators();

    while (true) {
      digitalWrite(
        LED_RED_PIN,
        !digitalRead(LED_RED_PIN)
      );
      delay(300);
    }
  }

  Serial.println(
    "BMP280 #1: OK"
  );

  Serial.println(
    "BMP280 #2: OK"
  );

  Serial.println(
    "TinyML model: flood_model.h"
  );

  Serial.println(
    "Features: 10"
  );

  Serial.println(
    "Window: 30 seconds"
  );

  Serial.println(
    "Sampling: 1 Hz"
  );

  Serial.println(
    "Inference: every 5 seconds"
  );

  Serial.println(
    "Confirmation: 3 consecutive predictions"
  );

  Serial.println();
  Serial.println(
    "Waiting for rolling window..."
  );
}

// ============================================================
// 17. MAIN LOOP
// ============================================================

void loop() {

  unsigned long now =
      millis();

  // ==========================================================
  // SAMPLE SENSOR DATA @ 1 Hz
  // ==========================================================

  if (
    now - lastSampleTime >=
    SAMPLE_INTERVAL_MS
  ) {

    lastSampleTime = now;

    // -----------------------------------------
    // Check BMP health
    // -----------------------------------------

    if (!bmpSensorsHealthy()) {

      Serial.println(
        "WARNING: BMP280 health check failed"
      );

      setSensorFaultIndicators();

      return;
    }

    // -----------------------------------------
    // Read sensors
    // -----------------------------------------

    float rawWater =
        readWaterLevelCm();

    float rawSoil =
        readSoilMoisturePct();

    float temperature =
        readAverageTemperatureC();

    float pressure =
        readAveragePressureHpa();

    if (
      isnan(temperature) ||
      isnan(pressure)
    ) {

      Serial.println(
        "ERROR: Invalid BMP reading"
      );

      setSensorFaultIndicators();

      return;
    }

    // -----------------------------------------
    // Filter
    // -----------------------------------------

    float water =
        filteredWaterReading(
          rawWater
        );

    float soil =
        filteredSoilReading(
          rawSoil
        );

    // First filter initialization is complete
    // after we have processed the first values.
    filtersInitialized = true;

    // -----------------------------------------
    // Add sample to rolling window
    // -----------------------------------------

    addSample(
      water,
      soil,
      temperature,
      pressure
    );

    // -----------------------------------------
    // Debug telemetry
    // -----------------------------------------

    Serial.print("SAMPLE ");
    Serial.print(samplesCollected);
    Serial.print("/");
    Serial.print(WINDOW_SIZE);

    Serial.print(
      " | Water="
    );
    Serial.print(water, 2);
    Serial.print(" cm");

    Serial.print(
      " | Soil="
    );
    Serial.print(soil, 2);
    Serial.print("%");

    Serial.print(
      " | Temp="
    );
    Serial.print(temperature, 2);
    Serial.print(" C");

    Serial.print(
      " | Pressure="
    );
    Serial.print(pressure, 2);
    Serial.println(" hPa");
  }

  // ==========================================================
  // RUN TINYML INFERENCE
  // ==========================================================

  if (
    now - lastInferenceTime >=
    INFERENCE_INTERVAL_MS
  ) {

    lastInferenceTime = now;

    runInference();
  }

  delay(5);
}
